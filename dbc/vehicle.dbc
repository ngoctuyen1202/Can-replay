VERSION ""

NS_ :

BS_:

BU_: EngineECU BodyECU

BO_ 256 EngineData: 8 EngineECU
 SG_ Speed : 0|8@1+ (1,0) [0|255] "" Vector__XXX

BO_ 512 DoorStatus: 1 BodyECU
 SG_ Door : 0|1@1+ (1,0) [0|1] "" Vector__XXX
